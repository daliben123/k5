## config/west.yml
```yaml
manifest:
  remotes:
    - name: daliben123
      url-base: https://github.com/daliben123
    - name: zmk-official
      url-base: https://github.com/zmkfirmware
    - name: badjeff
      url-base: https://github.com/badjeff/
    # Additional modules containing boards/shields/custom code can be listed here as well
    # See https://docs.zephyrproject.org/3.2.0/develop/west/manifest.html#projects
  projects:
    - name: zmk
      remote: daliben123 
      revision: main
      import: app/west.yml
    - name: zmk-analog-input-driver
      remote: badjeff
      revision: main
  self:
    path: config
```
